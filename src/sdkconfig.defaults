## src/sdkconfig.defaults
```kconfig
# Override some defaults so BT stack is enabled
# in this example and some example specific misc sizes are increased.

CONFIG_BT_ENABLED=y
CONFIG_BT_NIMBLE_ENABLED=y
CONFIG_BT_NIMBLE_ATT_PREFERRED_MTU=512
CONFIG_BT_NIMBLE_TRANSPORT_ACL_FROM_LL_COUNT=20
CONFIG_BT_NIMBLE_TRANSPORT_EVT_SIZE=255
CONFIG_BT_NIMBLE_MSYS_1_BLOCK_COUNT=50

CONFIG_ESPTOOLPY_FLASHSIZE_4MB=y
CONFIG_ESPTOOLPY_FLASHSIZE="4MB"

CONFIG_SPI_MASTER_IN_IRAM=y
CONFIG_ESP_SPI_BUS_LOCK_FUNCS_IN_IRAM=y

CONFIG_ESP_CONSOLE_UART_CUSTOM=y
CONFIG_ESP_CONSOLE_UART_BAUDRATE=2000000
#CONFIG_ESP_CONSOLE_SECONDARY_NONE=y
#CONFIG_BOOT_ROM_LOG_ALWAYS_OFF=y

CONFIG_LIBC_STDOUT_LINE_ENDING_LF=y
CONFIG_LIBC_STDIN_LINE_ENDING_LF=y

CONFIG_PARTITION_TABLE_SINGLE_APP_LARGE=y
CONFIG_BOOTLOADER_WDT_TIME_MS=20000
CONFIG_LWIP_IPV6_AUTOCONFIG=y
CONFIG_LWIP_IP6_FRAG=n
CONFIG_LWIP_UDP_RECVMBOX_SIZE=24
CONFIG_MBEDTLS_CERTIFICATE_BUNDLE=n
```
